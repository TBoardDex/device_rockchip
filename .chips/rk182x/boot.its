## .chips/rk182x/boot.its
```
/*
 * Copyright (C) 2025 Rockchip Electronics Co., Ltd
 *
 * SPDX-License-Identifier: GPL-2.0
 */

/dts-v1/;
/ {
    description = "Linux kernel and FDT blob";
    #address-cells = <1>;

    images {
        fdt {
	    description = "Flattened Device Tree blob";
	    data = /incbin/("./arch/riscv/boot/dts/rockchip/rk182x-evb1-v10.dtb");
            type = "flat_dt";
            arch = "riscv";
            compression = "none";
	    load = /bits/ 64 <0x540300000>;

            hash {
                algo = "sha256";
            };
        };

        kernel {
	    description = "RK1820 Linux kernel";
	    data = /incbin/("./arch/riscv/boot/Image");
            type = "kernel";
            arch = "riscv";
            os = "linux";
            compression = "none";
	    load = /bits/ 64 <0x540400000>;
	    entry = /bits/ 64 <0x540400000>;

            hash {
                algo = "sha256";
            };
        };
    };

    configurations {
        default = "conf";

        conf {
	    description = "Boot Linux kernel with FDT blob";
            fdt = "fdt";
            kernel = "kernel";

        };
    };
};
```

## .chips/rk1860/amp_linux.its
```
/* SPDX-License-Identifier: BSD-3-Clause */
/*
 * Copyright (c) 2026 Rockchip Electronics Co., Ltd.
 */

/dts-v1/;
/ {
	description = "FIT source file for rockchip AMP";
	#address-cells = <2>;

	images {
		amp3 {
			description  = "rtos-core3";
			data         = /incbin/("rtt3.bin");
			type         = "firmware";
			compression  = "none";
			arch         = "riscv";  // "arm64" or "arm" or "riscv"
			cpu          = <0x003>;  // hartid
			pass-fdt     = <1>;      // 0: U-Boot don't pass fdt addr; 1: pass
			load         = <0x30 0x04800000>;
			size         = <0x01400000>;
			udelay       = <10000>;

			compile {
				sys        = "rtt";
				core       = "ap";
				rtt_config = "board/fpga/defconfig";
				rtt_exec   = "prebuilts/gcc/linux-x86/riscv64/Xuantie-900-gcc-elf-newlib-x86_64-V3.3.0/bin";
				cc         = "prebuilts/gcc/linux-x86/riscv64/Xuantie-900-gcc-elf-newlib-x86_64-V3.3.0/bin/riscv64-unknown-elf-";
			};
			hash {
				algo = "sha256";
			};
		};
	};

	configurations {
		default = "conf";
		conf {
			description = "Rockchip AMP images";
			rollback-index = <0x0>;
			loadables = "amp3";

			signature {
				algo = "sha256,rsa2048";
				padding = "pss";
				key-name-hint = "dev";
				sign-images = "loadables";
			};

                        /* - run linux on cpu0
                         * - it is brought up by amp(that run on U-Boot)
                         * - it is boot entry depends on U-Boot
                         */
                        linux {
                                description  = "linux-os";
                                arch         = "riscv";
                                cpu          = <0x000>;
                                load         = <0x30 0x00600000>;
                                udelay       = <0>;
                        };
		};
	};
};
```

## .chips/rk3506/amp_mcu.its
```
/*
 * Copyright (C) 2024 Rockchip Electronics Co., Ltd
 *
 * SPDX-License-Identifier: GPL-2.0
 */

/dts-v1/;
/ {
	description = "Rockchip AMP FIT Image";
	#address-cells = <1>;

	images {
		mcu {
			description  = "mcu";
			data         = /incbin/("./mcu.bin");
			type         = "standalone";	// must be "standalone"
			compression  = "none";
			arch         = "arm";		// "arm64" or "arm", the same as U-Boot state
			load         = <0xfff84000>;
			udelay       = <1000000>;
			compile {
				sys      = "hal";
				core     = "mcu";
				rtt_exec     = "prebuilts/gcc/linux-x86/arm/gcc-arm-none-eabi-10-2020-q4-major-x86_64-linux/bin/"
				cc           = "prebuilts/gcc/linux-x86/arm/gcc-arm-none-eabi-10-2020-q4-major-x86_64-linux/bin/arm-none-eabi-"
				cc_prefix    = "arm-none-eabi-";
			};
			hash {
				algo = "sha256";
			};
		};
	};

	share {
		rpmsg_base       = <0x03c00000>;
		rpmsg_size       = <0x00200000>;
	};

	configurations {
		default = "conf";
		conf {
			description = "Rockchip AMP images";
			rollback-index = <0x0>;
			loadables = "mcu";

			signature {
				algo = "sha256,rsa2048";
				padding = "pss";
				key-name-hint = "dev";
				sign-images = "loadables";
			};
		};
	};
};
```

## .chips/rk3572/amp_mcu.its
```
/* SPDX-License-Identifier: BSD-3-Clause */
/*
 * Copyright (c) 2024 Rockchip Electronics Co., Ltd.
 */

/dts-v1/;
/ {
	description = "FIT source file for rockchip AMP";
	#address-cells = <1>;

	images {
		mcu {
			description  = "mcu";
			data         = /incbin/("rtt.bin");
			type         = "standalone";
			compression  = "none";
			arch         = "riscv";
			udelay       = <10000>;
			load         = <DTB:mcu_reserved:START>; // <0x45000000>;
			cpu          = <0>;
			compile {
				size         = <DTB:mcu_reserved:SIZE>; // <0x00200000>;
				sys          = "rtt";    // "hal" or "rtt"
				rtt_config   = "board/evb/amp_linux_defconfig"
				core         = "mcu";
				rtt_exec     = "prebuilts/gcc/linux-x86/riscv64/nuclei_riscv_newlibc_prebuilt_linux64_2025.02/bin/"
				cc           = "prebuilts/gcc/linux-x86/riscv64/nuclei_riscv_newlibc_prebuilt_linux64_2025.02/bin/riscv64-unknown-elf-"
			};

			hash {
				algo = "sha256";
			};
		};
	};

	share {
		rpmsg_base      = <DTB:rpmsg_reserved:START>; // <0x45400000>;
		rpmsg_size      = <DTB:rpmsg_reserved:SIZE+rpmsg_dma_reserved:SIZE>; // <0x00400000>;
	};

	configurations {
		default = "conf";
		conf {
			description = "Rockchip AMP images";
			rollback-index = <0x0>;
			loadables = "mcu";

			signature {
				algo = "sha256,rsa2048";
				padding = "pss";
				key-name-hint = "dev";
				sign-images = "loadables";
			};
		};
	};
};
```

## .chips/rk3576/tb-boot.its
```
/*
 * Copyright (C) 2026 Rockchip Electronics Co., Ltd
 *
 * SPDX-License-Identifier: GPL-2.0
 */

/dts-v1/;
/ {
    description = "U-Boot FIT source file for arm";

    images {
        fdt {
            description = "FDT";
            data = /incbin/("@KERNEL_DTB@");
            type = "flat_dt";
            arch = "arm64";
            compression = "none";

            load = <0x48300000>;
            hash {
                algo = "sha256";
            };
        };

        kernel {
            description = "Linux kernel";
            data = /incbin/("@KERNEL_IMG@");
            type = "kernel";
            arch = "arm64";
            os = "linux";
            compression = "gzip";
            comp = <@KERNEL_C@>;
            entry = <0x40400000>;
            load = <0x40400000>;

            hash {
                algo = "sha256";
            };
        };
    };

    configurations {
        default = "conf";
        conf {
            description = "Boot Linux kernel with FDT blob and no ramdisk";
            rollback-index = <0x0>;
            fdt = "fdt";
            kernel = "kernel";
            signature {
                algo = "sha256,rsa2048";
                padding = "pss";
                key-name-hint = "dev";
                sign-images = "fdt", "kernel";
            };
        };
    };
};
```
